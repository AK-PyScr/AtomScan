const uint8_t frame1[] PROGMEM = {
  0x00, 0x00, 0x00, 0x80, 0xc0, 0xe0, 0x70, 0x38, 0x98, 0xcc, 0xcc, 0x06, 0x06, 0x02, 0x03, 0x03, 
	0x03, 0x03, 0x03, 0x03, 0x03, 0x02, 0x06, 0x86, 0xcc, 0xcc, 0x98, 0x38, 0x70, 0xe0, 0xc0, 0x80, 
	0x00, 0x00, 0x00, 0xc0, 0xf8, 0x1e, 0x07, 0xf1, 0xfc, 0x0e, 0x07, 0x01, 0x00, 0x01, 0xc7, 0xfe, 
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	0x06, 0x02, 0x03, 0x03, 0x01, 0x01, 0x00, 0x00, 0x00, 0x00, 0x00, 0x00, 0x00, 0x00, 0x00
};

const uint8_t frame2[] PROGMEM = {
	// 'free-icon-radiation-1087050(2)', 35x35px
  0x00, 0x00, 0x00, 0x80, 0xc0, 0xe0, 0x70, 0x38, 0x18, 0x0c, 0x0c, 0x06, 0x06, 0x02, 0x03, 0x03, 
	0x03, 0xf3, 0x13, 0x33, 0x33, 0x32, 0x36, 0x66, 0xec, 0xcc, 0x98, 0x38, 0x70, 0xe0, 0xc0, 0x80, 
	0x00, 0x00, 0x00, 0xc0, 0xf8, 0x1e, 0x07, 0xf1, 0xfc, 0x0c, 0x0c, 0x18, 0x38, 0x30, 0xe0, 0xe0, 
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	0x06, 0x02, 0x03, 0x03, 0x01, 0x01, 0x00, 0x00, 0x00, 0x00, 0x00, 0x00, 0x00, 0x00, 0x00
};

const uint8_t frame3[] PROGMEM = {
	// 'free-icon-radiation-1087050(2)', 35x35px
	0x00, 0x00, 0x00, 0x80, 0xc0, 0xe0, 0x70, 0x38, 0x18, 0x0c, 0xec, 0xe6, 0x36, 0x32, 0x33, 0x33, 
	0x13, 0x13, 0x13, 0x33, 0x33, 0x32, 0x36, 0xe6, 0xec, 0x0c, 0x18, 0x38, 0x70, 0xe0, 0xc0, 0x80, 
	0x00, 0x00, 0x00, 0xc0, 0xf8, 0x1e, 0x07, 0x01, 0x00, 0x00, 0x00, 0x00, 0x00, 0x00, 0x03, 0x07, 
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	0x06, 0x02, 0x03, 0x03, 0x01, 0x01, 0x00, 0x00, 0x00, 0x00, 0x00, 0x00, 0x00, 0x00, 0x00
};

const uint8_t frame4[] PROGMEM = {
	// 'free-icon-radiation-1087050(2)', 35x35px
  0x00, 0x00, 0x00, 0x80, 0xc0, 0xe0, 0x70, 0x38, 0x98, 0xcc, 0x6c, 0x66, 0x36, 0x32, 0x33, 0x33, 
	0x13, 0xf3, 0x03, 0x03, 0x03, 0x02, 0x06, 0x06, 0x0c, 0x0c, 0x18, 0x38, 0x70, 0xe0, 0xc0, 0x80, 
	0x00, 0x00, 0x00, 0xc0, 0xf8, 0x1e, 0x07, 0x01, 0x00, 0x06, 0x0f, 0x0d, 0x18, 0x38, 0x30, 0x60, 
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	0x06, 0x02, 0x03, 0x03, 0x01, 0x01, 0x00, 0x00, 0x00, 0x00, 0x00, 0x00, 0x00, 0x00, 0x00
};

const uint8_t* frames[] = {frame1, frame2, frame3, frame4};  // Массив кадров

const int frameCount = 4;
unsigned long prevMillis = 0;
const int frameDelay = 500;  // Задержка между кадрами в миллисекундах
int currentFrame = 0;


unsigned long ledTimer = 0;
bool ledState = false;

void LED_blink(){                                           // при срабатывании датчика подаем высокий сигнал на 20мс 
  if (event && !ledState) {
      event = LOW;
      digitalWrite(LED_BUILTIN, HIGH);         
      ledState = true;                              
      ledTimer = millis();                         
      // Serial.println("bym");
    }  

    if (ledState && millis() - ledTimer >= 10) {
      digitalWrite(LED_BUILTIN, LOW);
      ledState = false;
    }
}

void print_to_display(){
    oled.setScale(1);
    oled.setCursor(35, 0);  
    oled.print("AtomScan");

    oled.setCursor(0, 1);  
    oled.println();
    oled.print("CPS: ");
    oled.println(CPS);

    oled.print("CPM: ");
    oled.println(CPM, 2);
    oled.println();
    oled.println();

    oled.print("DOZA: ");
    oled.println(doza, 2); 

    // oled.rect(4, 55, 124, 60, OLED_STROKE);  // прямоугольник скруглённый (лев. верхн, прав. нижн)
    // for(int l=4; l < 124; l++){
    //   for(int i = 55; i < 60; i++){
        
    //     oled.dot(l, i, OLED_FILL);    
    //   }
    //   delay(30);
    //   oled.update();
    // } 
    
    oled.update();
}

void updateAnimation() {
  unsigned long currentMillis = millis();
  if (CPM < 1.0){
    if (currentMillis - prevMillis >= frameDelay) {
      prevMillis = currentMillis;  // Обновляем время последнего кадра

      oled.clear();
      oled.drawBitmap(90, 0, frames[currentFrame], 35, 35);

    }
  }
  if (currentMillis - prevMillis >= frameDelay) {
    prevMillis = currentMillis;  // Обновляем время последнего кадра

    oled.clear();
    oled.drawBitmap(90, 0, frames[currentFrame], 35, 35);
    // oled.update();

    currentFrame = (currentFrame + 1) % frameCount;  // Зацикливание кадров
  }
}

void loop() {  
  CalculateCPM();
  LED_blink();
  print_to_display();
  updateAnimation();
}
